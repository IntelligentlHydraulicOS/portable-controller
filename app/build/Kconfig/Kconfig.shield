## app/build/app/Kconfig/arch/Kconfig.tmp
```kconfig
# Load Zephyr Arch Kconfig descriptions.
osource "/home/binbin/ncs-workspace/zephyr/arch/rx/Kconfig"
osource "/home/binbin/ncs-workspace/zephyr/arch/x86/Kconfig"
osource "/home/binbin/ncs-workspace/zephyr/arch/xtensa/Kconfig"
osource "/home/binbin/ncs-workspace/zephyr/arch/sparc/Kconfig"
osource "/home/binbin/ncs-workspace/zephyr/arch/riscv/Kconfig"
osource "/home/binbin/ncs-workspace/zephyr/arch/posix/Kconfig"
osource "/home/binbin/ncs-workspace/zephyr/arch/openrisc/Kconfig"
osource "/home/binbin/ncs-workspace/zephyr/arch/mips/Kconfig"
osource "/home/binbin/ncs-workspace/zephyr/arch/arm64/Kconfig"
osource "/home/binbin/ncs-workspace/zephyr/arch/arm/Kconfig"
osource "/home/binbin/ncs-workspace/zephyr/arch/arc/Kconfig"
```

## app/build/app/Kconfig/boards/Kconfig.defconfig
```kconfig
# Load Zephyr board defconfig descriptions.
osource "/home/binbin/ncs-workspace/zephyr/boards/nordic/nrf54l15dk/Kconfig.defconfig"
```

## app/build/app/Kconfig/boards/Kconfig.nrf54l15dk.tmp
```kconfig
# Load board Kconfig descriptions.
osource "/home/binbin/ncs-workspace/zephyr/boards/nordic/nrf54l15dk/Kconfig.nrf54l15dk"
```

## app/build/app/Kconfig/boards/Kconfig.sysbuild.tmp
```kconfig
# Load Sysbuild board Kconfig descriptions.
osource "/home/binbin/ncs-workspace/zephyr/boards/nordic/nrf54l15dk/Kconfig.sysbuild"
```
